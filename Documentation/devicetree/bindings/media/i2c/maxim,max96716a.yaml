## Documentation/devicetree/bindings/media/i2c/maxim,max96716a.yaml
```yaml
# SPDX-License-Identifier: (GPL-2.0-only OR BSD-2-Clause)
%YAML 1.2
---
$id: http://devicetree.org/schemas/media/i2c/maxim,max96716a.yaml#
$schema: http://devicetree.org/meta-schemas/core.yaml#

title: Maxim MAX96716A GMSL2 to CSI-2 Deserializer

maintainers:
  - BeagleY-AI Edge AI project

description: |
  The MAX96716A converts GMSL2 serial input to MIPI CSI-2. This binding
  describes the fixed single-link implementation that exposes one GMSL input
  and one CSI-2 output to V4L2.

properties:
  compatible:
    const: maxim,max96716a

  reg:
    maxItems: 1

  powerdown-gpios:
    maxItems: 1
    description: GPIO connected to the PWDNB pin.

  port0-poc-supply:
    description: Regulator providing Power over Coax for GMSL input 0.

  i2c-gate:
    $ref: /schemas/i2c/i2c-gate.yaml
    unevaluatedProperties: false
    description:
      Downstream I2C bus forwarded over the GMSL reverse channel. The
      MAX96717 serializer and its downstream sensor are described here.

  ports:
    $ref: /schemas/graph.yaml#/properties/ports

    properties:
      port@0:
        $ref: /schemas/graph.yaml#/properties/port
        description: GMSL2 input

      port@1:
        $ref: /schemas/graph.yaml#/$defs/port-base
        unevaluatedProperties: false
        description: CSI-2 output

        properties:
          endpoint:
            $ref: /schemas/media/video-interfaces.yaml#
            unevaluatedProperties: false

            properties:
              data-lanes:
                minItems: 4
                maxItems: 4

              lane-polarities:
                minItems: 2
                maxItems: 5

              link-frequencies:
                maxItems: 1

            required:
              - data-lanes
              - link-frequencies

    required:
      - port@0
      - port@1

required:
  - compatible
  - reg
  - ports

additionalProperties: false

examples:
  - |
    i2c {
        #address-cells = <1>;
        #size-cells = <0>;

        deserializer@28 {
            compatible = "maxim,max96716a";
            reg = <0x28>;

            ports {
                #address-cells = <1>;
                #size-cells = <0>;

                port@0 {
                    reg = <0>;
                    endpoint {};
                };

                port@1 {
                    reg = <1>;
                    endpoint {
                        data-lanes = <1 2 3 4>;
                        link-frequencies = /bits/ 64 <600000000>;
                    };
                };
            };
        };
    };
...
```

## Documentation/devicetree/bindings/media/i2c/ovti,ox03h10.yaml
```yaml
# SPDX-License-Identifier: (GPL-2.0-only OR BSD-2-Clause)
%YAML 1.2
---
$id: http://devicetree.org/schemas/media/i2c/ovti,ox03h10.yaml#
$schema: http://devicetree.org/meta-schemas/core.yaml#

title: OmniVision OX03H10 image sensor

maintainers:
  - BeagleY-AI Edge AI project

description: |
  The OX03H10 is a MIPI CSI-2 image sensor. This driver uses the BeagleY-AI
  profile for a 1920x1536 BGGR RAW12 60 fps output over four CSI-2 lanes.
  The board manages sensor rails and reset; the driver enables the serializer
  reference clock while streaming.

properties:
  compatible:
    const: ovti,ox03h10

  reg:
    maxItems: 1

  clocks:
    maxItems: 1

  clock-names:
    const: xvclk

  port:
    $ref: /schemas/graph.yaml#/$defs/port-base
    unevaluatedProperties: false
    description: MIPI CSI-2 output port

    properties:
      endpoint:
        $ref: /schemas/media/video-interfaces.yaml#
        unevaluatedProperties: false

        properties:
          data-lanes:
            minItems: 4
            maxItems: 4

          clock-lanes:
            maxItems: 1

          lane-polarities:
            minItems: 1
            maxItems: 5

          link-frequencies: true

        required:
          - data-lanes
          - link-frequencies

required:
  - compatible
  - reg
  - clocks
  - clock-names
  - port

additionalProperties: false

examples:
  - |
    camera_clock: clock {
        compatible = "fixed-clock";
        clock-frequency = <24000000>;
        #clock-cells = <0>;
    };

    i2c {
        #address-cells = <1>;
        #size-cells = <0>;

        camera@36 {
            compatible = "ovti,ox03h10";
            reg = <0x36>;

            clocks = <&camera_clock>;
            clock-names = "xvclk";


            port {
                camera_out: endpoint {
                    data-lanes = <1 2 3 4>;
                    clock-lanes = <0>;
                    link-frequencies = /bits/ 64 <750000000>;
                };
            };
        };
    };
...
```

## Documentation/devicetree/bindings/media/i2c/ovti,ox08d10.yaml
```yaml
# SPDX-License-Identifier: (GPL-2.0-only OR BSD-2-Clause)
%YAML 1.2
---
$id: http://devicetree.org/schemas/media/i2c/ovti,ox08d10.yaml#
$schema: http://devicetree.org/meta-schemas/core.yaml#

title: OmniVision OX08D10 image sensor

maintainers:
  - BeagleY-AI Project <fyx@localhost>

description: |
  Direct CSI-2 OX08D10 module using the TI four-lane HDR4 PWL12 profile.
  The module supplies its internal rails. clock-frequency describes an
  on-module oscillator when no controllable clock provider is connected.

properties:
  compatible:
    const: ovti,ox08d10
  reg:
    maxItems: 1
  clocks:
    maxItems: 1
  clock-names:
    items:
      - const: xvclk
  clock-frequency:
    const: 25000000
  enable-gpios:
    maxItems: 1
    description: Module enable, asserted to make the sensor accessible.
  reset-gpios:
    maxItems: 1
    description: Sensor reset, asserted during powerdown.
  pinctrl-names: true
  pinctrl-0: true
  port:
    $ref: /schemas/graph.yaml#/$defs/port-base
    additionalProperties: false
    properties:
      endpoint:
        $ref: /schemas/media/video-interfaces.yaml#
        unevaluatedProperties: false
        properties:
          data-lanes:
            items:
              - const: 1
              - const: 2
              - const: 3
              - const: 4
          link-frequencies:
            items:
              - const: 550000000
        required:
          - data-lanes
          - link-frequencies

required:
  - compatible
  - reg
  - port

anyOf:
  - required: [clocks]
  - required: [clock-frequency]

additionalProperties: false
```
